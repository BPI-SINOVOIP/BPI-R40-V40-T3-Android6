## lichee/linux-3.10/drivers/char/Transmit_Fm/Kconfig
```kconfig
config Transmit_FM_QN8027
	tristate "Transmit fm qn8027 support"
	default m
	help
	  If you say yes here you get support for fm Transmit with QN8027
```

## lichee/linux-3.10/drivers/media/platform/sunxi_car_reverse/Kconfig
```kconfig
#
# Platform drivers
#	All drivers here are currently for webcam support

config VIDEO_CAR_REVERSE
	tristate "Support car reverse driver"
	help
	  Support for the car reverse.
```

## lichee/linux-3.10/drivers/net/wireless/xradio/Kconfig
```kconfig
config XR_WLAN
	tristate "XRADIO WLAN support"
	default n
	select CFG80211
	select AVERAGE
	---help---
	  To compile this code as a module, choose M here.

if XR_WLAN

source "drivers/net/wireless/xradio/umac/Kconfig"
source "drivers/net/wireless/xradio/wlan/Kconfig"

endif # XR_WLAN
```
